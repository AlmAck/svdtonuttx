# DA1470x register map
Vendor: Dialog; Series: DA1470x; File version: 1.2
D2798AA
CPU: CM33 r0p2, little endian, MPU, FPU, DSP, VTOR, 4 interrupt priority bits
Registers are 32-bit, read-write, reset 0x0 unless marked. A register's access mark holds for its fields unless they carry their own. Offsets are from the block's base; lines under a group give offsets from that group; [hi:lo] are bit positions; {n}, {i} and the like mark numbered series; 'fields as' and 'values as' point back to an identical list; <NAME> marks a mode.

## Memory map
0x100C0000 CACHE size 0x54 — CACHE registers
0x30030000 LCDC size 0x800 — LCDC registers
0x30040000 AES_HASH size 0x104 — AES_HASH registers
0x30058000 EMMC size 0xF70 — EMMC registers
0x30100000 DCACHE size 0x28 — DCACHE registers
0x36000000 OQSPIF size 0x134 — OQSPIF registers
0x50000000 CRG_TOP size 0xFC — CRG_TOP registers
0x50000300 DCDC size 0x4 — DCDC registers
0x50000500 DCDC_BOOST size 0x18 — DCDC_BOOST registers
0x50000B00 CRG_VSYS size 0x10 — CRG_VSYS registers
0x50020500 I2C3 size 0xA8 — I2C3 registers
0x50020600 I2C size 0xA8 — I2C registers
0x50020700 I2C2 size 0xA8 — I2C2 registers
0x50020800 GPADC size 0x24 — GPADC registers
0x50020900 CRG_SNC size 0x10 — CRG_SNC registers
0x50020C00 I3C size 0x2A0 — I3C registers
0x50030000 CRG_AUD size 0x50 — CRG_AUD registers
0x50040100 GPREG size 0x1C — GPREG registers
0x50040300 CHG_DET size 0x28 — CHG_DET registers
0x50040400 CRG_SYS size 0x14 — CRG_SYS registers
0x50050000 MEMCTRL size 0x88 — MEMCTRL registers
0x50050100 GPIO size 0x184 — GPIO registers
0x50050400 CRG_XTAL size 0x9C — CRG_XTAL registers
0x50050600 ANAMISC_BIF size 0x20 — ANAMISC_BIF registers
0x50060000 CRG_CTRL size 0x8 — CRG_CTRL registers
0x51000400 DMA size 0x118 — DMA registers
0x51000600 CHARGER size 0x88 — CHARGER registers
0x51001000 CRG_GPU size 0x8 — CRG_GPU registers
0x51001100 GPU_REG size 0x4 — GPU_REG registers
0x51001200 GPU_CORE size 0xF8 — GPU_CORE registers
0x51001300 DSI2 size 0x1B0 — DSI2 registers
0x51001500 DSIDPHY_REG size 0x38 — DSIDPHY_REG registers

## Interrupts
0 CMAC2SYS (AES_HASH) — CMAC and mailbox interrupt request.
1 SNC2SYS (AES_HASH) — SNC M0+ interrupt to Cortex M33.
2 M33_Cache_MRM (AES_HASH) — CM33 Cache Miss Rate Monitor interrupt request.
3 PDC_M33 (AES_HASH) — Wakeup IRQ from PDC to CM33.
4 KEY_WKUP_GPIO (AES_HASH) — Debounced button press interrupt request.
5 VBUS (AES_HASH) — VBUS presence interrupt request.
6 CHARGER_STATE (AES_HASH) — Charger State interrupt request.
7 CHARGER_ERROR (AES_HASH) — Charger Error interrupt request.
8 DCDC_BOOST (AES_HASH) — DCDC boost controller interrupt request.
9 PLL48_LOCK (AES_HASH) — PLL48 lock interrupt request. Indicates that the PLL48 is locked at 48MHz.
10 CRYPTO (AES_HASH) — Crypto interrupt request.
11 PLL_LOCK (AES_HASH) — PLL lock interrupt request. Indicates that PLL is locked at 160MHz.
12 XTAL32M_RDY (AES_HASH) — XTAL32M trimmed and ready interrupt request.
13 RFDIAG (AES_HASH) — Baseband or Radio Diagnostics interrupt request.
14 GPIO_P0 (AES_HASH) — GPIO port 0 toggle interrupt request.
15 GPIO_P1 (AES_HASH) — GPIO port 1 toggle interrupt request.
16 GPIO_P2 (AES_HASH) — GPIO port 2 toggle interrupt request.
17 TIMER (AES_HASH) — TIMER interrupt request.
18 TIMER2 (AES_HASH) — TIMER2 interrupt request.
19 TIMER3 (AES_HASH) — TIMER3 interrupt request.
20 TIMER4 (AES_HASH) — TIMER4 interrupt request.
21 TIMER5 (AES_HASH) — TIMER5 interrupt request.
22 TIMER6 (AES_HASH) — TIMER6 interrupt request.
23 RTC (AES_HASH) — RTC interrupt request.
24 RTC_EVENT (AES_HASH) — RTC event interrupt request.
25 CAPTIMER (AES_HASH) — GPIO triggered Timer Capture interrupt request.
26 ADC (AES_HASH) — General Purpose Analog-Digital Converter interrupt request.
27 ADC2 (AES_HASH) — Application Analog-Digital Converter interrupt request.
28 DMA (AES_HASH) — General Purpose DMA interrupt request.
29 UART (AES_HASH) — UART interrupt request.
30 UART2 (AES_HASH) — UART2 interrupt request.
31 UART3 (AES_HASH) — UART3 interrupt request.
32 SPI (AES_HASH) — SPI interrupt request.
33 SPI2 (AES_HASH) — SPI2 interrupt request.
34 SPI3 (AES_HASH) — SPI3 interrupt request.
35 I2C (AES_HASH) — I2C interrupt request.
36 I2C2 (AES_HASH) — I2C2 interrupt request.
37 I2C3 (AES_HASH) — I2C3 interrupt request.
38 I3C (AES_HASH) — I3C interrupt request.
39 USB (AES_HASH) — USB interrupt request.
40 PCM (AES_HASH) — PCM interrupt request.
41 SRC_IN (AES_HASH) — SRC input interrupt request.
42 SRC_OUT (AES_HASH) — SRC output interrupt request.
43 SRC2_IN (AES_HASH) — SRC2 input interrupt request.
44 SRC2_OUT (AES_HASH) — SRC2 output interrupt request.
45 VAD (AES_HASH) — VAD interrupt request.
46 eMMC (AES_HASH) — eMMC controller interrupt request.
47 SDIO (AES_HASH) — SDIO controller interrupt request.
48 GPU (AES_HASH) — GPU interrupt request to Cortex M33.
49 LCD (AES_HASH) — LCD controller interrupt request.
50 DSI (AES_HASH) — DSI/D-PHY interrupt request.
51 CHARGER_DET (AES_HASH) — Charger detection interrupt request.
52 DCACHE_MRM (AES_HASH) — Data cache MRM interrupt request.
53 CLK_CALIBRATION (AES_HASH) — Clock calibration interrupt request.
54 VSYS_GEN (AES_HASH) — VSYS generator interrupt request.
55 RESERVED55 (AES_HASH) — SoftWare interrupt request.

## Licence text in the file
Copyright (C) 2020 Dialog Semiconductor. This computer program includes Confidential, Proprietary Information of Dialog Semiconductor. All Rights Reserved.
